## config/west.yml
```yaml
manifest:
  remotes:
    - name: zmkfirmware
      url-base: https://github.com/zmkfirmware
    # Prospector Scanner
    - name: prospector
      url-base: https://github.com/t-ogura
  projects:
    - name: zmk
      remote: zmkfirmware
      revision: v0.3
      import: app/west.yml
    # Prospector Scanner
    - name: prospector-zmk-module
      remote: prospector
      repo-path: prospector-zmk-module
      revision: v2.0.0
      path: modules/prospector-zmk-module
  self:
    path: config
```
